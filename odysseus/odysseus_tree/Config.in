## odysseus/odysseus_tree/package/nanomq/Config.in
```kconfig
config BR2_PACKAGE_NANOMQ
    bool "nanomq"
    help
        An edge computing MQTT broker and bridge engine from emgx


if BR2_PACKAGE_NANOMQ

comment "Build options"

config BR2_PACKAGE_NANOMQ_QUIC
    bool "QUIC"
    default n
    help
        to build NanoMQ with QUIC bridging feature.

        Custom note: Uses a custom patched OpenSSL which complicates build.
        Edit the makefile to achieve correct build params.

config BR2_PACKAGE_NANOMQ_AWS_BRIDGE
    bool "AWS Bridging"
    default n
    help
        Enables the AWS IoT Core bridging feature.

        Note: This feature is not compatible with MQTT over QUIC bridging. 
        Users can operate only one type of bridging at a time.

config BR2_PACKAGE_NANOMQ_TLS
    bool "TLS"
    default n
    depends on BR2_PACKAGE_MBEDTLS
    help
        to build with TLS support

config BR2_PACKAGE_NANOMQ_CLIENT_SUITE
    bool "client suite"
    default y
    help
        nanomq tools client suite (including pub / sub / conn )

config BR2_PACKAGE_NANOMQ_ZMQ_GATEWAY
    bool "ZMQ gateway"
    default n
    help
        to build nanomq_cli with zeromq gateway too

config BR2_PACKAGE_NANOMQ_DDS_PROXY
    bool "DDS Proxy"
    default n
    help
        to build nanomq_cli with dds client ( proxy / sub / pub )

config BR2_PACKAGE_NANOMQ_VSOMEIP_GATEWAY
    bool "vsomeip gateway"
    default n
    help
        Build vsomeip gateway

config BR2_PACKAGE_NANOMQ_NNG_PROXY
    bool "NNG Proxy"
    default n
    help
        Build nng proxy

config BR2_PACKAGE_NANOMQ_BENCH
    bool "bench"
    default n
    help
        to build nanomq_cli mqtt bench

config BR2_PACKAGE_NANOMQ_JWT
    bool "JWT"
    default n
    help
        to build JWT dependency for http server

config BR2_PACKAGE_NANOMQ_SQLITE
    bool "sqlite"
    help
        to build nanomq with sqlite support

config BR2_PACKAGE_NANOMQ_STATICLIB
    bool "Static library"
    default n
    help
        Builds as a static library

config BR2_PACKAGE_NANOMQ_DISABLE_SHAREDLIB
    bool "Disable shared library"
    help
        Builds as a shared library

config BR2_PACKAGE_NANOMQ_DEBUG
    bool "ddebug"
    help
        Enables the debug flag.

config BR2_PACKAGE_NANOMQ_DASAN
    bool "Sanitizer"
    help
        Enables sanitizer.

config BR2_PACKAGE_NANOMQ_LOG
    bool "Logging"
    default y
    help
        Disable the log system to improve system performance

config BR2_PACKAGE_NANOMQ_TRACE
    bool "trace"
    default n
    help
        Enables ptrace, allowing process tracing and inspection.

config BR2_PACKAGE_NANOMQ_RULE_ENGINE
    bool "Rule engine"
    default n
    help
        Enable rule engine

config BR2_PACKAGE_NANOMQ_MYSQL
    bool "MySQL"
    default n
    help
        Enable MySQL

config BR2_PACKAGE_NANOMQ_ACL
    bool "ACL"
    default y
    help
        Enable ACL

config BR2_PACKAGE_NANOMQ_SYSLOG
    bool "syslog"
    default y
    help
        Enable syslog

config BR2_PACKAGE_NANOMQ_TESTS
    bool "tests"
    default n
    help
        Enable nanomqy unit tests

config BR2_PACKAGE_NANOMQ_PLUGIN
    bool "plugin support"
    default n
    help
	Enable plugin support

if BR2_PACKAGE_NANOMQ_PLUGIN
    
config BR2_PACKAGE_NANOMQ_PLUGIN_LIST
    string "list of plugins"
    help
	Space seperated path lists of plugins.
        Remeber to add them to the conf file yourself.

endif


endif
```

## odysseus/odysseus_tree/package/nerifenslave/Config.in
```kconfig
config BR2_PACKAGE_NERIFENSLAVE
	bool "nerifenslave"
	depends on BR2_PACKAGE_BUSYBOX_SHOW_OTHERS
	depends on BR2_PACKAGE_IFUPDOWN_SCRIPTS
	help
	  Configure network interfaces for parallel routing (bonding)

	  https://salsa.debian.org/debian/ifenslave
```

## odysseus/odysseus_tree/package/nermosquitto/Config.in.host
```kconfig
config BR2_PACKAGE_HOST_NERMOSQUITTO # ***
	bool "host ner mosquitto (mosquitto_passwd)" # ***
	help
	  Only installs mosquitto_passwd.
```

## odysseus/odysseus_tree/package/nero2/Config.in
```kconfig
config BR2_PACKAGE_NERO2
    bool "nero2"
    depends on BR2_PACKAGE_NERQT6 && BR2_PACKAGE_NERQT6BASE_NETWORK && BR2_PACKAGE_NERQT6BASE_WIDGETS && BR2_PACKAGE_NERQT6BASE_PNG && BR2_PACKAGE_NERQT6CHARTS
    depends on BR2_PACKAGE_NERQT6DECLARATIVE && BR2_PACKAGE_NERQT6DECLARATIVE_QUICK
    depends on BR2_PACKAGE_NERQT6MQTT && BR2_PACKAGE_NERQT6GRPC && BR2_PACKAGE_NERQT6CORE5COMPAT && BR2_PACKAGE_NERQT6SVG
    help
        Nero v2.0 custom dashboard for NER.

        Built with qt6.
        
        https://github.com/Northeastern-Electric-Racing/Nero-2.0
```

## odysseus/odysseus_tree/package/nerqt6/nerqt6grpc/Config.in
```kconfig
# NER: new package (no in tree equivalent)
config BR2_PACKAGE_NERQT6GRPC
	bool "nerqt6grpc"
	select BR2_PACKAGE_HOST_NERQT6BASE
	help
	  Qt is a cross-platform application and UI framework for
	  developers using C++.

	  Providing protobuf and gRPC support for Qt.

	  https://doc.qt.io/qt-6/qtshadertools-index.html
```

## odysseus/odysseus_tree/package/nerqt6/nerqt6mqtt/Config.in
```kconfig
# NER: new package!
config BR2_PACKAGE_NERQT6MQTT
	bool "nerqt6mqtt"
	help
	  Qt is a cross-platform application and UI framework for
	  developers using C++.

	  The Qt MQTT module provides a standard compliant
	  implementation of the MQTT protocol specification. It
	  enables applications to act as telemetry displays and
	  devices to publish telemetry data.  The supported versions
	  are MQTT 3.1, MQTT 3.1.1, and MQTT 5.0.

	  https://doc.qt.io/qt-6/qtmqtt-index.html
```

## odysseus/odysseus_tree/package/nrc-cli-app/Config.in
```kconfig
config BR2_PACKAGE_NRC_CLI
	bool "nrc cli app"
	help
		This is the application used for configuring the NRC7292 Wifi HaLow SoC
```

## odysseus/odysseus_tree/package/nrc-cli/Config.in
```kconfig
config BR2_PACKAGE_NRC_CLI
	bool "nrc-cli"
    depends on BR2_PACKAGE_NRC7292
	help
		This is the application used for configuring the NRC Wifi HaLow SoC
```

## odysseus/odysseus_tree/package/nrc-module/Config.in
```kconfig
config BR2_PACKAGE_HAS_NRC_MODULE
    depends on BR2_LINUX_KERNEL
    bool

config BR2_PACKAGE_PROVIDES_NRC_MODULE
    depends on BR2_PACKAGE_HAS_NRC_MODULE
    string
```

## odysseus/odysseus_tree/package/nrc-userspace-sta/Config.in
```kconfig
config BR2_PACKAGE_NRC_USERSPACE_STA
    bool "nrc-userspace-sta"
    depends on BR2_PACKAGE_NRC_CLI
    select BR2_PACKAGE_WPA_SUPPLICANT
    select BR2_PACKAGE_DHCPCD
    help
      Extra misc scripting for STA mode of nrc-userspace.
      Includes a hook to set txpwr and guard interval
```

## odysseus/odysseus_tree/package/nrc/Config.in
```kconfig
# this is a virtual package which allows a package to depend on nrc and not the specific board (ex. 7292)
config BR2_PACKAGE_HAS_NRC
    depends on BR2_LINUX_KERNEL
    depends on BR2_PACKAGE_WIRELESS_REGDB
    bool

config BR2_PACKAGE_PROVIDES_NRC
    depends on BR2_PACKAGE_HAS_NRC
    string
```

## odysseus/odysseus_tree/package/nrc7292-module/Config.in
```kconfig
config BR2_PACKAGE_NRC7292_MODULE
	bool "nrc7292-module"
        select BR2_PACKAGE_HAS_NRC_MODULE
	help
		This is the driver for the NRC7292 Wifi HaLow SoC

if BR2_PACKAGE_NRC7292_MODULE
config BR2_PACKAGE_PROVIDES_NRC_MODULE
    default "nrc7292-module"
endif
```

## odysseus/odysseus_tree/package/nrc7292/Config.in
```kconfig
config BR2_PACKAGE_NRC7292
	bool "nrc7292"
    select BR2_PACKAGE_HAS_NRC
	help
		This is the driver for the NRC7292 Wifi HaLow SoC

if BR2_PACKAGE_NRC7292

config BR2_PACKAGE_PROVIDES_NRC
	default "nrc7292"

config BR2_PACKAGE_NRC7292_CUSTOM_BD_FILE
	string "custom BD file"
	help
		Custom board data file to be installed to firmware (ex. ALFA's)
		If not specified, will use board data file for nrc7292 EVK hardware

endif
```

## odysseus/odysseus_tree/package/nrc7394/Config.in
```kconfig
config BR2_PACKAGE_NRC7394
	bool "nrc7394"
    select BR2_PACKAGE_HAS_NRC
	help
		This is the driver for the NRC7394 Wifi HaLow SoC

if BR2_PACKAGE_NRC7394

config BR2_PACKAGE_PROVIDES_NRC
	default "nrc7394"

config BR2_PACKAGE_NRC7394_CUSTOM_BD_FILE
	string "custom BD file"
	help
		Custom board data file to be installed to firmware (ex. ALFA's)
		If not specified, will use board data file for nrc7394 EVK hardware

config BR2_PACKAGE_NRC7394_CUSTOM_DTOVERLAY_FILE
	string "custom DTO file"
	help
		Custom dtoverlay file to be installed to overlays.
		If not specified, the default linux > 5.16 spi 0.1 will be used.

endif
```

## odysseus/odysseus_tree/package/python-gmqtt/Config.in
```kconfig
config BR2_PACKAGE_PYTHON_GMQTT
	bool "python-gmqtt"
	help
	  Client for MQTT protocol.

	  https://github.com/wialon/gmqtt
```
