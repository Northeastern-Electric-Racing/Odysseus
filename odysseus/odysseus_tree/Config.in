## odysseus/odysseus_tree/Config.in
```kconfig
source "$BR2_EXTERNAL_ODY_TREE_PATH/package/nrc/Config.in"
source "$BR2_EXTERNAL_ODY_TREE_PATH/package/nrc7292/Config.in"
source "$BR2_EXTERNAL_ODY_TREE_PATH/package/nrc7394/Config.in"
source "$BR2_EXTERNAL_ODY_TREE_PATH/package/nrc-cli/Config.in"
source "$BR2_EXTERNAL_ODY_TREE_PATH/package/nrc-init-extra/Config.in"
source "$BR2_EXTERNAL_ODY_TREE_PATH/package/alfa-led/Config.in"
source "$BR2_EXTERNAL_ODY_TREE_PATH/package/nanomq/Config.in"
source "$BR2_EXTERNAL_ODY_TREE_PATH/package/auto-modloader/Config.in"
source "$BR2_EXTERNAL_ODY_TREE_PATH/package/rpi-dtloader/Config.in"
source "$BR2_EXTERNAL_ODY_TREE_PATH/package/nero2/Config.in"
source "$BR2_EXTERNAL_ODY_TREE_PATH/package/nerqt6/Config.in"
```

## odysseus/odysseus_tree/configs/raspberrypi3_64_ap_defconfig
```kconfig
BR2_aarch64=y
BR2_ARM_FPU_VFPV4=y
BR2_KERNEL_HEADERS_6_1=y
BR2_TOOLCHAIN_BUILDROOT_CXX=y
BR2_CCACHE=y
BR2_CCACHE_DIR="$(HOME)/Projects/.buildroot-ccache"
BR2_TARGET_GENERIC_HOSTNAME="rasberrypi-ap"
BR2_TARGET_GENERIC_ISSUE="Welcome to odysseus, NER custom linux (for AP)"
BR2_TARGET_GENERIC_ROOT_PASSWD="password"
BR2_ROOTFS_OVERLAY="$(BR2_EXTERNAL_ODY_TREE_PATH)/overlays/rootfs_overlay_common $(BR2_EXTERNAL_ODY_TREE_PATH)/overlays/rootfs_overlay_ap"
BR2_ROOTFS_PRE_BUILD_SCRIPT="$(BR2_EXTERNAL_ODY_TREE_PATH)/pre-make-ap.sh"
BR2_ROOTFS_POST_BUILD_SCRIPT="board/raspberrypi3-64/post-build.sh"
BR2_ROOTFS_POST_IMAGE_SCRIPT="board/raspberrypi3-64/post-image.sh"
BR2_LINUX_KERNEL=y
BR2_LINUX_KERNEL_CUSTOM_TARBALL=y
BR2_LINUX_KERNEL_CUSTOM_TARBALL_LOCATION="$(call github,raspberrypi,linux,17f135b742c4edb340afb365873c3a574f7e16cb)/linux-17f135b742c4edb340afb365873c3a574f7e16cb.tar.gz"
BR2_LINUX_KERNEL_DEFCONFIG="bcmrpi3"
BR2_LINUX_KERNEL_DTS_SUPPORT=y
BR2_LINUX_KERNEL_INTREE_DTS_NAME="broadcom/bcm2710-rpi-3-b broadcom/bcm2710-rpi-3-b-plus broadcom/bcm2837-rpi-3-b"
BR2_LINUX_KERNEL_NEEDS_HOST_OPENSSL=y
BR2_PACKAGE_LINUX_TOOLS_GPIO=y
BR2_PACKAGE_BUSYBOX_SHOW_OTHERS=y
BR2_PACKAGE_XZ=y
BR2_PACKAGE_RPI_FIRMWARE=y
BR2_PACKAGE_RPI_FIRMWARE_BOOTCODE_BIN=y
BR2_PACKAGE_RPI_FIRMWARE_VARIANT_PI=y
BR2_PACKAGE_RPI_FIRMWARE_CONFIG_FILE="$(BR2_EXTERNAL_ODY_TREE_PATH)/board/ap/config.txt"
BR2_PACKAGE_RPI_FIRMWARE_CMDLINE_FILE="$(BR2_EXTERNAL_ODY_TREE_PATH)/board/common/cmdline.txt"
BR2_PACKAGE_LM_SENSORS=y
BR2_PACKAGE_RASPI_GPIO=y
BR2_PACKAGE_CA_CERTIFICATES=y
BR2_PACKAGE_BMON=y
BR2_PACKAGE_BRIDGE_UTILS=y
BR2_PACKAGE_DHCPCD=y
BR2_PACKAGE_DROPBEAR=y
BR2_PACKAGE_HOSTAPD=y
BR2_PACKAGE_IPERF3=y
BR2_PACKAGE_IPROUTE2=y
BR2_PACKAGE_IPUTILS=y
BR2_PACKAGE_IW=y
BR2_PACKAGE_WIRELESS_REGDB=y
BR2_PACKAGE_HTOP=y
BR2_PACKAGE_KMOD=y
BR2_PACKAGE_KMOD_TOOLS=y
BR2_PACKAGE_NANO=y
BR2_TARGET_ROOTFS_EXT2=y
BR2_TARGET_ROOTFS_EXT2_4=y
BR2_TARGET_ROOTFS_EXT2_SIZE="2G"
# BR2_TARGET_ROOTFS_TAR is not set
BR2_PACKAGE_HOST_DOSFSTOOLS=y
BR2_PACKAGE_HOST_GENIMAGE=y
BR2_PACKAGE_HOST_KMOD_XZ=y
BR2_PACKAGE_HOST_MTOOLS=y
BR2_PACKAGE_NRC7292=y
BR2_PACKAGE_NRC7292_CUSTOM_BD_FILE="$(BR2_EXTERNAL_ODY_TREE_PATH)/package/nrc7292/nrc7292_alfa_bd.dat"
BR2_PACKAGE_NRC_CLI=y
BR2_PACKAGE_NRC_INIT_EXTRA=y
BR2_PACKAGE_ALFA_LED=y
BR2_PACKAGE_ALFA_LED_AP=y
BR2_PACKAGE_AUTO_MODLOADER=y
BR2_PACKAGE_RPI_DTLOADER=y
BR2_PACKAGE_RPI_DTLOADER_FILES="$(BR2_EXTERNAL_ODY_TREE_PATH)/sources/nrc7292_sw_pkg/dts/newracom_for_5.16_or_later.dts"
```

## odysseus/odysseus_tree/configs/raspberrypi4_64_defconfig
```kconfig
BR2_aarch64=y
BR2_cortex_a72=y
BR2_ARM_FPU_VFPV4=y
BR2_TOOLCHAIN_EXTERNAL=y
BR2_CCACHE=y
BR2_TARGET_GENERIC_HOSTNAME="odysseus"
BR2_TARGET_GENERIC_ISSUE="Welcome to odysseus, NER custom linux"
BR2_TARGET_GENERIC_ROOT_PASSWD="password"
BR2_ROOTFS_POST_BUILD_SCRIPT="board/raspberrypi4-64/post-build.sh"
BR2_ROOTFS_POST_IMAGE_SCRIPT="board/raspberrypi4-64/post-image.sh"
BR2_LINUX_KERNEL=y
BR2_LINUX_KERNEL_CUSTOM_TARBALL=y
BR2_LINUX_KERNEL_CUSTOM_TARBALL_LOCATION="$(call github,raspberrypi,linux,0b54dbda3cca2beb51e236a25738784e90853b64)/linux-0b54dbda3cca2beb51e236a25738784e90853b64.tar.gz"
BR2_LINUX_KERNEL_DEFCONFIG="bcm2711"
BR2_LINUX_KERNEL_DTS_SUPPORT=y
BR2_LINUX_KERNEL_INTREE_DTS_NAME="broadcom/bcm2711-rpi-4-b"
BR2_LINUX_KERNEL_NEEDS_HOST_OPENSSL=y
BR2_PACKAGE_RPI_FIRMWARE=y
BR2_PACKAGE_RPI_FIRMWARE_VARIANT_PI4=y
BR2_PACKAGE_RPI_FIRMWARE_CONFIG_FILE="board/raspberrypi4-64/config_4_64bit.txt"
BR2_PACKAGE_GPSD=y
BR2_PACKAGE_GPSD_DEVICES="/dev/ttyACM0"
BR2_PACKAGE_LM_SENSORS=y
BR2_PACKAGE_PPS_TOOLS=y
BR2_PACKAGE_RASPI_GPIO=y
BR2_PACKAGE_UTIL_LINUX=y
BR2_TARGET_ROOTFS_EXT2=y
BR2_TARGET_ROOTFS_EXT2_4=y
BR2_TARGET_ROOTFS_EXT2_SIZE="120M"
# BR2_TARGET_ROOTFS_TAR is not set
BR2_PACKAGE_HOST_DOSFSTOOLS=y
BR2_PACKAGE_HOST_GENIMAGE=y
BR2_PACKAGE_HOST_MTOOLS=y
```

## odysseus/odysseus_tree/configs/raspberrypi4_64_nero_defconfig
```kconfig
BR2_aarch64=y
BR2_cortex_a72=y
BR2_ARM_FPU_VFPV4=y
BR2_TOOLCHAIN_EXTERNAL=y
BR2_CCACHE=y
BR2_GLOBAL_PATCH_DIR="$(BR2_EXTERNAL_ODY_TREE_PATH)/patches"
BR2_PER_PACKAGE_DIRECTORIES=y
BR2_TARGET_GENERIC_HOSTNAME="rasberrypi-nero"
BR2_TARGET_GENERIC_ISSUE="Welcome to odysseus, NER custom linux"
BR2_ROOTFS_DEVICE_CREATION_DYNAMIC_EUDEV=y
BR2_TARGET_GENERIC_ROOT_PASSWD="password"
BR2_ROOTFS_OVERLAY="$(BR2_EXTERNAL_ODY_TREE_PATH)/overlays/rootfs_overlay_hostapd_common $(BR2_EXTERNAL_ODY_TREE_PATH)/overlays/rootfs_overlay_nero"
BR2_ROOTFS_PRE_BUILD_SCRIPT="$(BR2_EXTERNAL_ODY_TREE_PATH)/pre-make-common.sh"
BR2_ROOTFS_POST_BUILD_SCRIPT="board/raspberrypi4-64/post-build.sh"
BR2_ROOTFS_POST_IMAGE_SCRIPT="board/raspberrypi4-64/post-image.sh"
BR2_LINUX_KERNEL=y
BR2_LINUX_KERNEL_CUSTOM_TARBALL=y
BR2_LINUX_KERNEL_CUSTOM_TARBALL_LOCATION="$(call github,raspberrypi,linux,17f135b742c4edb340afb365873c3a574f7e16cb)/linux-17f135b742c4edb340afb365873c3a574f7e16cb.tar.gz"
BR2_LINUX_KERNEL_DEFCONFIG="bcm2711"
BR2_LINUX_KERNEL_DTS_SUPPORT=y
BR2_LINUX_KERNEL_INTREE_DTS_NAME="broadcom/bcm2711-rpi-4-b"
BR2_LINUX_KERNEL_NEEDS_HOST_OPENSSL=y
BR2_PACKAGE_LINUX_TOOLS_GPIO=y
BR2_PACKAGE_BUSYBOX_SHOW_OTHERS=y
BR2_PACKAGE_XZ=y
BR2_PACKAGE_E2FSPROGS=y
BR2_PACKAGE_E2FSPROGS_RESIZE2FS=y
BR2_PACKAGE_DEJAVU=y
# BR2_PACKAGE_DEJAVU_SANS is not set
# BR2_PACKAGE_DEJAVU_SERIF is not set
# BR2_PACKAGE_DEJAVU_SANS_CONDENSED is not set
# BR2_PACKAGE_DEJAVU_SERIF_CONDENSED is not set
BR2_PACKAGE_KMSCUBE=y
BR2_PACKAGE_MESA3D=y
BR2_PACKAGE_MESA3D_GALLIUM_DRIVER_V3D=y
BR2_PACKAGE_MESA3D_OPENGL_ES=y
BR2_PACKAGE_BRCMFMAC_SDIO_FIRMWARE_RPI=y
BR2_PACKAGE_BRCMFMAC_SDIO_FIRMWARE_RPI_BT=y
BR2_PACKAGE_BRCMFMAC_SDIO_FIRMWARE_RPI_WIFI=y
BR2_PACKAGE_RPI_FIRMWARE=y
BR2_PACKAGE_RPI_FIRMWARE_VARIANT_PI4=y
BR2_PACKAGE_RPI_FIRMWARE_CONFIG_FILE="$(BR2_EXTERNAL_ODY_TREE_PATH)/board/nero/config.txt"
BR2_PACKAGE_RPI_FIRMWARE_CMDLINE_FILE="$(BR2_EXTERNAL_ODY_TREE_PATH)/board/common/cmdline.txt"
BR2_PACKAGE_LM_SENSORS=y
BR2_PACKAGE_RASPI_GPIO=y
BR2_PACKAGE_PYTHON3=y
BR2_PACKAGE_CA_CERTIFICATES=y
BR2_PACKAGE_PIXMAN=y
BR2_PACKAGE_BMON=y
BR2_PACKAGE_CAN_UTILS=y
BR2_PACKAGE_DHCPCD=y
BR2_PACKAGE_DNSMASQ=y
BR2_PACKAGE_DROPBEAR=y
BR2_PACKAGE_GESFTPSERVER=y
BR2_PACKAGE_HOSTAPD=y
BR2_PACKAGE_IPERF3=y
BR2_PACKAGE_IPROUTE2=y
BR2_PACKAGE_IPUTILS=y
BR2_PACKAGE_IW=y
BR2_PACKAGE_SOCKETCAND=y
BR2_PACKAGE_WIRELESS_REGDB=y
BR2_PACKAGE_HTOP=y
BR2_PACKAGE_KMOD_TOOLS=y
BR2_PACKAGE_NANO=y
BR2_TARGET_ROOTFS_EXT2=y
BR2_TARGET_ROOTFS_EXT2_4=y
BR2_TARGET_ROOTFS_EXT2_SIZE="4G"
# BR2_TARGET_ROOTFS_TAR is not set
BR2_PACKAGE_HOST_DOSFSTOOLS=y
BR2_PACKAGE_HOST_GENIMAGE=y
BR2_PACKAGE_HOST_KMOD_XZ=y
BR2_PACKAGE_HOST_MTOOLS=y
BR2_PACKAGE_HOST_PYTHON3=y
BR2_PACKAGE_NANOMQ=y
BR2_PACKAGE_NANOMQ_QUIC=y
BR2_PACKAGE_NANOMQ_BENCH=y
BR2_PACKAGE_NANOMQ_SQLITE=y
BR2_PACKAGE_NANOMQ_DISABLE_SHAREDLIB=y
BR2_PACKAGE_RPI_DTLOADER=y
BR2_PACKAGE_NERO2=y
BR2_PACKAGE_NERQT6=y
BR2_PACKAGE_NERQT6BASE_EGLFS=y
BR2_PACKAGE_NERQT6BASE_DEFAULT_QPA="eglfs"
BR2_PACKAGE_NERQT6BASE_WIDGETS=y
BR2_PACKAGE_NERQT6BASE_NETWORK=y
BR2_PACKAGE_NERQT6BASE_SYSLOG=y
BR2_PACKAGE_NERQT6DECLARATIVE=y
BR2_PACKAGE_NERQT6DECLARATIVE_QUICK=y
BR2_PACKAGE_NERQT6MQTT=y
BR2_PACKAGE_CALYPSO=y
```

## odysseus/odysseus_tree/configs/raspberrypi4_64_tpu_defconfig
```kconfig
BR2_aarch64=y
BR2_cortex_a72=y
BR2_ARM_FPU_VFPV4=y
BR2_TOOLCHAIN_EXTERNAL=y
BR2_CCACHE=y
BR2_GLOBAL_PATCH_DIR="$(BR2_EXTERNAL_ODY_TREE_PATH)/patches"
BR2_TARGET_GENERIC_HOSTNAME="rasberrypi-sta"
BR2_TARGET_GENERIC_ISSUE="Welcome to odysseus, NER custom linux"
BR2_TARGET_GENERIC_ROOT_PASSWD="password"
BR2_ROOTFS_OVERLAY="$(BR2_EXTERNAL_ODY_TREE_PATH)/overlays/rootfs_overlay_common $(BR2_EXTERNAL_ODY_TREE_PATH)/overlays/rootfs_overlay_tpu"
BR2_ROOTFS_PRE_BUILD_SCRIPT="$(BR2_EXTERNAL_ODY_TREE_PATH)/pre-make-common.sh $(BR2_EXTERNAL_ODY_TREE_PATH)/pre-make-sta.sh"
BR2_ROOTFS_POST_BUILD_SCRIPT="board/raspberrypi4-64/post-build.sh"
BR2_ROOTFS_POST_IMAGE_SCRIPT="board/raspberrypi4-64/post-image.sh"
BR2_LINUX_KERNEL=y
BR2_LINUX_KERNEL_CUSTOM_TARBALL=y
BR2_LINUX_KERNEL_CUSTOM_TARBALL_LOCATION="$(call github,raspberrypi,linux,17f135b742c4edb340afb365873c3a574f7e16cb)/linux-17f135b742c4edb340afb365873c3a574f7e16cb.tar.gz"
BR2_LINUX_KERNEL_DEFCONFIG="bcm2711"
BR2_LINUX_KERNEL_DTS_SUPPORT=y
BR2_LINUX_KERNEL_INTREE_DTS_NAME="broadcom/bcm2711-rpi-4-b"
BR2_LINUX_KERNEL_NEEDS_HOST_OPENSSL=y
BR2_PACKAGE_LINUX_TOOLS_GPIO=y
BR2_PACKAGE_BUSYBOX_SHOW_OTHERS=y
BR2_PACKAGE_XZ=y
BR2_PACKAGE_DEJAVU=y
# BR2_PACKAGE_DEJAVU_SANS is not set
# BR2_PACKAGE_DEJAVU_SERIF is not set
# BR2_PACKAGE_DEJAVU_SANS_CONDENSED is not set
# BR2_PACKAGE_DEJAVU_SERIF_CONDENSED is not set
BR2_PACKAGE_KMSCUBE=y
BR2_PACKAGE_MESA3D=y
BR2_PACKAGE_MESA3D_GALLIUM_DRIVER_V3D=y
BR2_PACKAGE_MESA3D_OPENGL_ES=y
BR2_PACKAGE_RPI_FIRMWARE=y
BR2_PACKAGE_RPI_FIRMWARE_VARIANT_PI4=y
BR2_PACKAGE_RPI_FIRMWARE_CONFIG_FILE="$(BR2_EXTERNAL_ODY_TREE_PATH)/board/tpu/config.txt"
BR2_PACKAGE_RPI_FIRMWARE_CMDLINE_FILE="$(BR2_EXTERNAL_ODY_TREE_PATH)/board/common/cmdline.txt"
BR2_PACKAGE_GPSD=y
BR2_PACKAGE_GPSD_DEVICES="/dev/ttyACM0"
BR2_PACKAGE_GPSD_PYTHON=y
BR2_PACKAGE_GPSD_UBX=y
BR2_PACKAGE_LM_SENSORS=y
BR2_PACKAGE_PPS_TOOLS=y
BR2_PACKAGE_RASPI_GPIO=y
# BR2_PACKAGE_PYTHON3_UNICODEDATA is not set
BR2_PACKAGE_CA_CERTIFICATES=y
BR2_PACKAGE_CAIRO=y
BR2_PACKAGE_BMON=y
BR2_PACKAGE_CAN_UTILS=y
BR2_PACKAGE_CHRONY=y
BR2_PACKAGE_DHCPCD=y
BR2_PACKAGE_DROPBEAR=y
BR2_PACKAGE_GESFTPSERVER=y
BR2_PACKAGE_IPERF3=y
BR2_PACKAGE_IPROUTE2=y
BR2_PACKAGE_IPUTILS=y
BR2_PACKAGE_IW=y
BR2_PACKAGE_SOCKETCAND=y
BR2_PACKAGE_WIRELESS_REGDB=y
BR2_PACKAGE_WPA_SUPPLICANT=y
BR2_PACKAGE_WPA_SUPPLICANT_CLI=y
BR2_PACKAGE_DOCKER_CLI=y
BR2_PACKAGE_DOCKER_COMPOSE=y
BR2_PACKAGE_DOCKER_ENGINE=y
BR2_PACKAGE_HTOP=y
BR2_PACKAGE_KMOD=y
BR2_PACKAGE_KMOD_TOOLS=y
BR2_PACKAGE_UTIL_LINUX_FSCK=y
BR2_PACKAGE_NANO=y
BR2_TARGET_ROOTFS_EXT2=y
BR2_TARGET_ROOTFS_EXT2_4=y
BR2_TARGET_ROOTFS_EXT2_SIZE="4G"
# BR2_TARGET_ROOTFS_TAR is not set
BR2_PACKAGE_HOST_DOSFSTOOLS=y
BR2_PACKAGE_HOST_GENIMAGE=y
BR2_PACKAGE_HOST_KMOD_XZ=y
BR2_PACKAGE_HOST_MTOOLS=y
BR2_PACKAGE_HOST_PYTHON3=y
BR2_PACKAGE_NRC7292=y
BR2_PACKAGE_NRC7292_CUSTOM_BD_FILE="$(BR2_EXTERNAL_ODY_TREE_PATH)/package/nrc7292/nrc7292_alfa_bd.dat"
BR2_PACKAGE_NRC_CLI=y
BR2_PACKAGE_NRC_INIT_EXTRA=y
BR2_PACKAGE_ALFA_LED=y
BR2_PACKAGE_NANOMQ=y
BR2_PACKAGE_NANOMQ_QUIC=y
BR2_PACKAGE_NANOMQ_BENCH=y
BR2_PACKAGE_NANOMQ_SQLITE=y
BR2_PACKAGE_NANOMQ_DISABLE_SHAREDLIB=y
BR2_PACKAGE_AUTO_MODLOADER=y
BR2_PACKAGE_RPI_DTLOADER=y
BR2_PACKAGE_RPI_DTLOADER_FILES="$(BR2_EXTERNAL_ODY_TREE_PATH)/package/nrc7292/newracom_for_5-16_or_later.dts"
BR2_PACKAGE_NERO2=y
BR2_PACKAGE_NERQT6=y
BR2_PACKAGE_NERQT6BASE_EGLFS=y
BR2_PACKAGE_NERQT6BASE_DEFAULT_QPA="eglfs"
BR2_PACKAGE_NERQT6BASE_WIDGETS=y
BR2_PACKAGE_NERQT6BASE_NETWORK=y
BR2_PACKAGE_NERQT6BASE_SYSLOG=y
BR2_PACKAGE_NERQT6DECLARATIVE=y
BR2_PACKAGE_NERQT6DECLARATIVE_QUICK=y
BR2_PACKAGE_NERQT6MQTT=y
```

## odysseus/odysseus_tree/configs/tpu_defconfig
```kconfig
BR2_aarch64=y
BR2_ARM_FPU_VFPV4=y
BR2_PACKAGE_HOST_LINUX_HEADERS_CUSTOM_5_10=y
BR2_TOOLCHAIN_BUILDROOT_CXX=y
BR2_TARGET_GENERIC_HOSTNAME="odyssey"
BR2_TARGET_GENERIC_ISSUE="Welcome to Odyssey"
BR2_TARGET_GENERIC_ROOT_PASSWD="ner"
BR2_SYSTEM_BIN_SH_ZSH=y
BR2_SYSTEM_DHCP="eth0"
BR2_ROOTFS_POST_BUILD_SCRIPT="board/raspberrypi3-64/post-build.sh"
BR2_ROOTFS_POST_IMAGE_SCRIPT="board/raspberrypi3-64/post-image.sh"
BR2_LINUX_KERNEL=y
BR2_LINUX_KERNEL_CUSTOM_TARBALL=y
BR2_LINUX_KERNEL_CUSTOM_TARBALL_LOCATION="$(call github,raspberrypi,linux,0b54dbda3cca2beb51e236a25738784e90853b64)/linux-0b54dbda3cca2beb51e236a25738784e90853b64.tar.gz"
BR2_LINUX_KERNEL_DEFCONFIG="bcmrpi3"
BR2_LINUX_KERNEL_DTS_SUPPORT=y
BR2_LINUX_KERNEL_INTREE_DTS_NAME="broadcom/bcm2710-rpi-3-b broadcom/bcm2710-rpi-3-b-plus broadcom/bcm2837-rpi-3-b"
BR2_LINUX_KERNEL_INSTALL_TARGET=y
BR2_LINUX_KERNEL_NEEDS_HOST_OPENSSL=y
BR2_PACKAGE_BUSYBOX_SHOW_OTHERS=y
BR2_PACKAGE_GZIP=y
BR2_PACKAGE_XZ=y
BR2_PACKAGE_GDB=y
BR2_PACKAGE_GDB_DEBUGGER=y
BR2_PACKAGE_STRESS=y
BR2_PACKAGE_GREP=y
BR2_PACKAGE_BTRFS_PROGS=y
BR2_PACKAGE_FIRMWARE_UTILS=y
BR2_PACKAGE_FUSE_OVERLAYFS=y
BR2_PACKAGE_RPI_FIRMWARE=y
BR2_PACKAGE_RPI_FIRMWARE_BOOTCODE_BIN=y
BR2_PACKAGE_RPI_FIRMWARE_VARIANT_PI=y
BR2_PACKAGE_RPI_FIRMWARE_CONFIG_FILE="board/raspberrypi3-64/config_3_64bit.txt"
BR2_PACKAGE_MDIO_TOOLS=y
BR2_PACKAGE_MINICOM=y
BR2_PACKAGE_OPENOCD=y
BR2_PACKAGE_PERL=y
BR2_PACKAGE_PYTHON3=y
BR2_PACKAGE_LIBCURL=y
BR2_PACKAGE_LIBCURL_CURL=y
BR2_PACKAGE_LIBWEBSOCK=y
BR2_PACKAGE_LIBWEBSOCKETS=y
BR2_PACKAGE_PROTOBUF=y
BR2_PACKAGE_PROTOBUF_C=y
BR2_PACKAGE_ARP_SCAN=y
BR2_PACKAGE_CAN_UTILS=y
BR2_PACKAGE_DHCP=y
BR2_PACKAGE_DHCP_SERVER=y
BR2_PACKAGE_DHCP_CLIENT=y
BR2_PACKAGE_DHCPCD=y
BR2_PACKAGE_DNSMASQ=y
BR2_PACKAGE_DROPBEAR=y
BR2_PACKAGE_IPERF3=y
BR2_PACKAGE_IW=y
BR2_PACKAGE_IWD=y
BR2_PACKAGE_NMAP=y
BR2_PACKAGE_NTP=y
BR2_PACKAGE_NTP_NTPDATE=y
BR2_PACKAGE_NTP_NTPTIME=y
BR2_PACKAGE_DOCKER_CLI=y
BR2_PACKAGE_DOCKER_ENGINE=y
BR2_PACKAGE_HTOP=y
BR2_PACKAGE_KMOD=y
BR2_PACKAGE_KMOD_TOOLS=y
BR2_PACKAGE_NANO=y
BR2_PACKAGE_UEMACS=y
BR2_PACKAGE_VIM=y
BR2_TARGET_ROOTFS_EXT2=y
BR2_TARGET_ROOTFS_EXT2_4=y
BR2_TARGET_ROOTFS_EXT2_SIZE="500M"
# BR2_TARGET_ROOTFS_TAR is not set
BR2_PACKAGE_HOST_DOSFSTOOLS=y
BR2_PACKAGE_HOST_GENIMAGE=y
BR2_PACKAGE_HOST_MTOOLS=y
```

## odysseus/odysseus_tree/package/alfa-led-sta/Config.in
```kconfig
config BR2_PACKAGE_ALFA_LED_STA
    bool "alfa-led-sta"
    depends on BR2_PACKAGE_NRC_CLI
    depends on BR2_PACKAGE_IPUTILS
    depends on BR2_PACKAGE_IPROUTE2
    help
      Installs the ALFA led userspace runner for the NRC networking board 
```

## odysseus/odysseus_tree/package/alfa-led/Config.in
```kconfig
config BR2_PACKAGE_ALFA_LED
    bool "alfa-led"
    depends on BR2_PACKAGE_NRC_CLI
    depends on BR2_PACKAGE_IPUTILS
    depends on BR2_PACKAGE_IPROUTE2
    help
      Installs the ALFA led userspace runner for the NRC networking board in STA mode

if BR2_PACKAGE_ALFA_LED

config BR2_PACKAGE_ALFA_LED_AP
    bool "ap mode"
    default n
    depends on BR2_PACKAGE_HOSTAPD
    help
        Show LEDs in AP mode instead of STA mode if selected
endif
```

## odysseus/odysseus_tree/package/auto-modloader/Config.in
```kconfig
config BR2_PACKAGE_AUTO_MODLOADER
    bool "auto-modloader"
    help
        A init script that modprobes all modules located in /etc/modules
        Use /etc/modprobe.d to specify params for loading
```

## odysseus/odysseus_tree/package/calypso/Config.in
```kconfig
config BR2_PACKAGE_CALYPSO
    bool "calypso"
    depends on BR2_PACKAGE_HOST_RUSTC_TARGET_ARCH_SUPPORTS
    depends on BR2_PACKAGE_OPENSSL
    select BR2_PACKAGE_HOST_RUSTC
    help
        The NER CAN message decoding software.
        
        Written in Rust, utlizing socketcand.
        
        https://github.com/Northeastern-Electric-Racing/Calypso
	
if BR2_PACKAGE_CALYPSO

config BR2_PACKAGE_CALYPSO_BROKER_IP
	string "broker ip"
	default "localhost:1883"
	
endif
```
