## odysseus/odysseus_tree/package/rpi-dtloader/Config.in
```kconfig
config BR2_PACKAGE_RPI_DTLOADER
    bool "load more RPI DTS files"
    depends on BR2_LINUX_KERNEL_DTB_OVERLAY_SUPPORT
    help
        Load extra device tree overlay (DTS) files into
        the sdcard.img


if BR2_PACKAGE_RPI_DTLOADER

config BR2_PACKAGE_RPI_DTLOADER_FILES
    string "extra RPI DTS files"
    help
        Extra DTS files to be compiled and loaded in the sdcard.img.
        Space seperated list, to activate each enter dtoverlay=<name>
        (without the .dts) in the config.txt of the pi.
        
        Note: periods in filename besides extension period not allowed!!

endif
```

## odysseus/odysseus_tree/package/tpu-telemetry/Config.in
```kconfig
config BR2_PACKAGE_TPU_TELEMETRY
    bool "tpu telemetry sending"
    select BR2_PACKAGE_PYTHON_GMQTT
    select BR2_PACKAGE_PYTHON_PSUTIL
    select BR2_PACKAGE_PYTHON_PROTOBUF
    select BR2_PACKAGE_PYTHON_CAN
    depends on BR2_PACKAGE_GPSD_PYTHON
    help
        Fast script scrape and send 
        TPU data to a MQTT broker locally.
```

## odysseus_tree/configs/raspberrypi3_64_iroh_defconfig
```kconfig
BR2_aarch64=y
BR2_ARM_FPU_VFPV4=y
BR2_TOOLCHAIN_EXTERNAL=y
BR2_CCACHE=y
BR2_GLOBAL_PATCH_DIR="$(BR2_EXTERNAL_ODY_TREE_PATH)/patches board/raspberrypi/patches"
BR2_PER_PACKAGE_DIRECTORIES=y
BR2_TARGET_GENERIC_HOSTNAME="raspberrypi-iroh"
BR2_ROOTFS_DEVICE_CREATION_DYNAMIC_EUDEV=y
BR2_TARGET_GENERIC_ROOT_PASSWD="$(ODY_IROH_ROOT_PASSWORD)"
# BR2_TARGET_GENERIC_GETTY is not set
BR2_TARGET_TZ_INFO=y
BR2_TARGET_LOCALTIME="America/New_York"
BR2_ROOTFS_OVERLAY="$(BR2_EXTERNAL_ODY_TREE_PATH)/overlays/rootfs_overlay_common $(BR2_EXTERNAL_ODY_TREE_PATH)/overlays/rootfs_overlay_iroh"
BR2_ROOTFS_POST_BUILD_SCRIPT="$(BR2_EXTERNAL_ODY_TREE_PATH)/post-build-os-release.sh $(BR2_EXTERNAL_ODY_TREE_PATH)/post-build-base-connect.sh board/raspberrypi3-64/post-build.sh"
BR2_ROOTFS_POST_IMAGE_SCRIPT="board/raspberrypi3-64/post-image.sh"
BR2_ROOTFS_POST_SCRIPT_ARGS="IROH"
BR2_LINUX_KERNEL=y
BR2_LINUX_KERNEL_CUSTOM_TARBALL=y
BR2_LINUX_KERNEL_CUSTOM_TARBALL_LOCATION="$(call github,raspberrypi,linux,576cc10e1ed50a9eacffc7a05c796051d7343ea4)/linux-576cc10e1ed50a9eacffc7a05c796051d7343ea4.tar.gz"
BR2_LINUX_KERNEL_DEFCONFIG="bcmrpi3"
BR2_LINUX_KERNEL_DTS_SUPPORT=y
BR2_LINUX_KERNEL_INTREE_DTS_NAME="broadcom/bcm2710-rpi-3-b broadcom/bcm2710-rpi-3-b-plus broadcom/bcm2710-rpi-cm3"
BR2_LINUX_KERNEL_NEEDS_HOST_OPENSSL=y
BR2_PACKAGE_LINUX_TOOLS_GPIO=y
BR2_PACKAGE_BUSYBOX_SHOW_OTHERS=y
BR2_PACKAGE_XZ=y
BR2_PACKAGE_ZSTD=y
BR2_PACKAGE_E2FSPROGS=y
BR2_PACKAGE_E2FSPROGS_RESIZE2FS=y
BR2_PACKAGE_BRCMFMAC_SDIO_FIRMWARE_RPI=y
BR2_PACKAGE_BRCMFMAC_SDIO_FIRMWARE_RPI_BT=y
BR2_PACKAGE_BRCMFMAC_SDIO_FIRMWARE_RPI_WIFI=y
BR2_PACKAGE_RPI_FIRMWARE=y
BR2_PACKAGE_RPI_FIRMWARE_BOOTCODE_BIN=y
BR2_PACKAGE_RPI_FIRMWARE_VARIANT_PI=y
BR2_PACKAGE_RPI_FIRMWARE_CONFIG_FILE="$(BR2_EXTERNAL_ODY_TREE_PATH)/board/iroh/config.txt"
BR2_PACKAGE_RPI_FIRMWARE_CMDLINE_FILE="$(BR2_EXTERNAL_ODY_TREE_PATH)/board/iroh/cmdline.txt"
BR2_PACKAGE_LM_SENSORS=y
BR2_PACKAGE_RASPI_GPIO=y
BR2_PACKAGE_PYTHON3=y
BR2_PACKAGE_CA_CERTIFICATES=y
BR2_PACKAGE_OPENSSL=y
BR2_PACKAGE_BMON=y
BR2_PACKAGE_CAN_UTILS=y
BR2_PACKAGE_DHCPCD=y
BR2_PACKAGE_DROPBEAR=y
BR2_PACKAGE_GESFTPSERVER=y
# BR2_PACKAGE_IFUPDOWN_SCRIPTS is not set
BR2_PACKAGE_IPERF3=y
BR2_PACKAGE_IPROUTE2=y
BR2_PACKAGE_IPUTILS=y
BR2_PACKAGE_IW=y
BR2_PACKAGE_WIRELESS_REGDB=y
BR2_PACKAGE_WPA_SUPPLICANT=y
BR2_PACKAGE_WPA_SUPPLICANT_DEBUG_SYSLOG=y
BR2_PACKAGE_WPA_SUPPLICANT_CLI=y
BR2_PACKAGE_WPA_SUPPLICANT_PASSPHRASE=y
BR2_PACKAGE_HTOP=y
BR2_PACKAGE_KMOD_TOOLS=y
BR2_PACKAGE_NANO=y
BR2_TARGET_ROOTFS_EXT2=y
BR2_TARGET_ROOTFS_EXT2_4=y
BR2_TARGET_ROOTFS_EXT2_SIZE="2G"
# BR2_TARGET_ROOTFS_TAR is not set
BR2_PACKAGE_HOST_DOSFSTOOLS=y
BR2_PACKAGE_HOST_GENIMAGE=y
BR2_PACKAGE_HOST_KMOD_XZ=y
BR2_PACKAGE_HOST_MTOOLS=y
BR2_PACKAGE_HOST_PYTHON3=y
BR2_PACKAGE_CALYPSO=y
BR2_PACKAGE_CALYPSO_BROKER_IP="192.168.100.1:1883"
BR2_PACKAGE_MQTTUI=y
BR2_PACKAGE_RPI_UTILS=y
BR2_PACKAGE_RPI_UTILS_PINCTRL=y
```

## odysseus_tree/configs/raspberrypi4_64_nero_debug_defconfig
```kconfig
BR2_aarch64=y
BR2_cortex_a72=y
BR2_ARM_FPU_VFPV4=y
BR2_TOOLCHAIN_BUILDROOT_CXX=y
BR2_CCACHE=y
BR2_GLOBAL_PATCH_DIR="$(BR2_EXTERNAL_ODY_TREE_PATH)/patches"
BR2_PER_PACKAGE_DIRECTORIES=y
BR2_PACKAGE_DEJAVU=y
# BR2_PACKAGE_DEJAVU_SANS is not set
# BR2_PACKAGE_DEJAVU_SERIF is not set
# BR2_PACKAGE_DEJAVU_SANS_CONDENSED is not set
# BR2_PACKAGE_DEJAVU_SERIF_CONDENSED is not set
BR2_PACKAGE_KMSCUBE=y
BR2_PACKAGE_MESA3D=y
BR2_PACKAGE_MESA3D_GALLIUM_DRIVER_V3D=y
BR2_PACKAGE_MESA3D_OPENGL_ES=y
BR2_PACKAGE_NERO2=y
BR2_PACKAGE_NERQT6=y
BR2_PACKAGE_NERQT6BASE_EGLFS=y
BR2_PACKAGE_NERQT6BASE_DEFAULT_QPA="eglfs"
BR2_PACKAGE_NERQT6BASE_JPEG=y
BR2_PACKAGE_NERQT6BASE_PNG=y
BR2_PACKAGE_NERQT6BASE_WIDGETS=y
BR2_PACKAGE_NERQT6BASE_NETWORK=y
BR2_PACKAGE_NERQT6BASE_SYSLOG=y
BR2_PACKAGE_NERQT6CORE5COMPAT=y
BR2_PACKAGE_NERQT6SVG=y
BR2_PACKAGE_NERQT6DECLARATIVE=y
BR2_PACKAGE_NERQT6DECLARATIVE_QUICK=y
BR2_PACKAGE_NERQT6MQTT=y
BR2_PACKAGE_NERQT6GRPC=y
```

## odysseus_tree/package/mqttui/Config.in
```kconfig
config BR2_PACKAGE_MQTTUI
    bool "mqttui"
    depends on BR2_PACKAGE_HOST_RUSTC_TARGET_ARCH_SUPPORTS
    select BR2_PACKAGE_HOST_RUSTC
    help
        MQTT inspection and publishing TUI.
        
        https://github.com/EdJoPaTo/mqttui
```

## odysseus_tree/package/nerqt6/nerqt6base/Config.in.host
```kconfig
# NER: new file!
config BR2_PACKAGE_HOST_NERQT6BASE
	bool "host QT6Base"
	depends on BR2_HOST_GCC_AT_LEAST_8
	help
	  This option enables the host Qt6 framework.

	  http://qt.io

if BR2_PACKAGE_HOST_NERQT6BASE

config BR2_PACKAGE_HOST_NERQT6BASE_GUI
  bool "GUI support"
  help
    Enable GUI support. Needed for the qsb package from
    the host-qt6shadertools packages

config BR2_PACKAGE_HOST_NERQT6BASE_NETWORK
  bool "Networking support"
  help
    Enables networking support. Needed for the qmlprofiler
    tool in host-qt6declarative

endif
```

## odysseus_tree/package/nerqt6/nerqt6charts/Config.in
```kconfig
# NER new package
config BR2_PACKAGE_NERQT6CHARTS
	bool "nerqt6charts"
	help
	  Qt is a cross-platform application and UI framework for
	  developers using C++.

	  The Qt Charts module provides a set of easy-to-use chart components. 
	  It uses the Qt Graphics View Framework to integrate charts with modern user interfaces.

	  https://doc.qt.io/qt-6/qtcharts-index.html
```

## odysseus_tree/package/nerqt6/nerqt6declarative/Config.in
```kconfig
# NER: new package!
config BR2_PACKAGE_NERQT6DECLARATIVE
	bool "nerqt6declarative"
	select BR2_PACKAGE_NERQT6SHADERTOOLS
	select BR2_PACKAGE_HOST_NERQT6BASE_NETWORK
	help
            Qt is a cross-platform application and UI framework for
            developers using C++.

             Qt Declarative module provides the Qt QML and Qt Quick
             modules for developing UIs with the QML language

              https://doc.qt.io/qt-6/qtqml-index.html
              https://doc.qt.io/qt-6/qtquick-index.html



if BR2_PACKAGE_NERQT6DECLARATIVE

config BR2_PACKAGE_NERQT6DECLARATIVE_QUICK
	bool "quick module"
	select BR2_PACKAGE_NERQT6BASE_GUI
	select BR2_PACKAGE_NERQT6BASE_OPENGL if BR2_PACKAGE_NERQT6_GL_SUPPORTS

endif
```

## odysseus_tree/package/nerqt6/nerqt6shadertools/Config.in
```kconfig
# NER: new package (no in tree equivalent)
config BR2_PACKAGE_NERQT6SHADERTOOLS
	bool "nerqt6shadertools"
	select BR2_PACKAGE_HOST_NERQT6BASE
	select BR2_PACKAGE_NERQT6BASE_GUI
	select BR2_PACKAGE_HOST_NERQT6BASE_GUI
	help
	  Qt is a cross-platform application and UI framework for
	  developers using C++.

	  The Qt Shader Tools module builds on the SPIR-V Open
	  Source Ecosystem as described at the Khronos SPIR-V web
	  site.

	  https://doc.qt.io/qt-6/qtshadertools-index.html
```

## odysseus_tree/package/nrc-init-extra/Config.in
```kconfig
config BR2_PACKAGE_NRC_INIT_EXTRA
    bool "nrc init extra"
    depends on BR2_PACKAGE_NRC_CLI
    help
      Extra misc scripting for nrc userspace.
      Includes a hook to set txpwr and guard interval
```

## odysseus_tree/package/rpi-utils/Config.in
```kconfig
menuconfig BR2_PACKAGE_RPI_UTILS
	bool "misc. rpi utilities"
	depends on BR2_PACKAGE_RPI_FIRMWARE
	help
	  Various raspberry pi utilities.
	  
	  Currently only some supported.
	  
	  https://github.com/raspberrypi/utils

if BR2_PACKAGE_RPI_UTILS

source "$BR2_EXTERNAL_ODY_TREE_PATH/package/rpi-utils/rpi-utils-eeptools/Config.in"
source "$BR2_EXTERNAL_ODY_TREE_PATH/package/rpi-utils/rpi-utils-pinctrl/Config.in"



endif
```

## odysseus_tree/package/rpi-utils/rpi-utils-pinctrl/Config.in
```kconfig
config BR2_PACKAGE_RPI_UTILS_PINCTRL
    bool "see pin statuses"
    help
        Replaces raspi-gpio
```

## odysseus_tree/package/usbip/Config.in
```kconfig
config BR2_PACKAGE_USBIP
	bool "usbip"
	depends on BR2_PACKAGE_HAS_UDEV
	depends on BR2_TOOLCHAIN_HAS_THREADS # usbutils <- libusb
	depends on !BR2_STATIC_LIBS
	select BR2_PACKAGE_USBUTILS
	select BR2_PACKAGE_HWDATA # for naming of usb devices (large pkg)
	help
	  usbip is a set of tools that allows machines to share their
  	  usb devices over the network, to be driven by a remote client. 
```
