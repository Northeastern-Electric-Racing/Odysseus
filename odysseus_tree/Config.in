## odysseus_tree/Config.in
```kconfig
source "$BR2_EXTERNAL_ODY_TREE_PATH/package/nrc/Config.in"
source "$BR2_EXTERNAL_ODY_TREE_PATH/package/nrc7292/Config.in"
source "$BR2_EXTERNAL_ODY_TREE_PATH/package/nrc7394/Config.in"
source "$BR2_EXTERNAL_ODY_TREE_PATH/package/nrc-cli/Config.in"
source "$BR2_EXTERNAL_ODY_TREE_PATH/package/nrc-init-extra/Config.in"
source "$BR2_EXTERNAL_ODY_TREE_PATH/package/alfa-led/Config.in"
source "$BR2_EXTERNAL_ODY_TREE_PATH/package/nanomq/Config.in"
source "$BR2_EXTERNAL_ODY_TREE_PATH/package/rpi-dtloader/Config.in"
source "$BR2_EXTERNAL_ODY_TREE_PATH/package/nero2/Config.in"
source "$BR2_EXTERNAL_ODY_TREE_PATH/package/calypso/Config.in"
source "$BR2_EXTERNAL_ODY_TREE_PATH/package/mqttui/Config.in"
source "$BR2_EXTERNAL_ODY_TREE_PATH/package/rpi-utils/Config.in"
source "$BR2_EXTERNAL_ODY_TREE_PATH/package/python-gmqtt/Config.in"
source "$BR2_EXTERNAL_ODY_TREE_PATH/package/odysseus-daemon/Config.in"
source "$BR2_EXTERNAL_ODY_TREE_PATH/package/wheel-buttons/Config.in"
source "$BR2_EXTERNAL_ODY_TREE_PATH/package/morse/Config.in"
source "$BR2_EXTERNAL_ODY_TREE_PATH/package/rpi-libpisp/Config.in"
source "$BR2_EXTERNAL_ODY_TREE_PATH/package/rpi-libcamera/Config.in"
source "$BR2_EXTERNAL_ODY_TREE_PATH/package/rpicam-apps/Config.in"
source "$BR2_EXTERNAL_ODY_TREE_PATH/package/microchip-t1s/Config.in"
```

## odysseus_tree/configs/raspberrypicm5io_tpu_defconfig
```kconfig
BR2_aarch64=y
BR2_cortex_a76=y
BR2_KERNEL_HEADERS_6_6=y
BR2_TOOLCHAIN_BUILDROOT_CXX=y
BR2_CCACHE=y
BR2_GLOBAL_PATCH_DIR="$(BR2_EXTERNAL_ODY_TREE_PATH)/patches board/raspberrypi/patches"
BR2_PER_PACKAGE_DIRECTORIES=y
BR2_TARGET_GENERIC_HOSTNAME="raspberrypi-sta"
BR2_ROOTFS_DEVICE_CREATION_DYNAMIC_EUDEV=y
BR2_TARGET_GENERIC_ROOT_PASSWD="$(ODY_TPU_ROOT_PASSWORD)"
# BR2_TARGET_GENERIC_GETTY is not set
BR2_TARGET_TZ_INFO=y
BR2_TARGET_LOCALTIME="America/New_York"
BR2_ROOTFS_OVERLAY="$(BR2_EXTERNAL_ODY_TREE_PATH)/overlays/rootfs_overlay_common $(BR2_EXTERNAL_ODY_TREE_PATH)/overlays/rootfs_overlay_nrc_common $(BR2_EXTERNAL_ODY_TREE_PATH)/overlays/rootfs_overlay_odyssey_common $(BR2_EXTERNAL_ODY_TREE_PATH)/overlays/rootfs_overlay_tpu $(BR2_EXTERNAL_ODY_TREE_PATH)/overlays/rootfs_overlay_tpu_cm5"
BR2_ROOTFS_POST_BUILD_SCRIPT="$(BR2_EXTERNAL_ODY_TREE_PATH)/post-build-sta.sh $(BR2_EXTERNAL_ODY_TREE_PATH)/post-build-os-release.sh $(BR2_EXTERNAL_ODY_TREE_PATH)/post-build-base-connect.sh board/raspberrypicm5io/post-build.sh"
BR2_ROOTFS_POST_IMAGE_SCRIPT="board/raspberrypicm5io/post-image.sh"
BR2_ROOTFS_POST_SCRIPT_ARGS="TPU"
BR2_LINUX_KERNEL=y
BR2_LINUX_KERNEL_CUSTOM_TARBALL=y
BR2_LINUX_KERNEL_CUSTOM_TARBALL_LOCATION="$(call github,MorseMicro,rpi-linux,f746aa8a795b1330f4664b9c46d558a614b7114d)/linux-f746aa8a795b1330f4664b9c46d558a614b7114d.tar.gz"
BR2_LINUX_KERNEL_DEFCONFIG="bcm2712"
BR2_LINUX_KERNEL_CONFIG_FRAGMENT_FILES="board/raspberrypi/linux-4k-page-size.fragment"
BR2_LINUX_KERNEL_DTS_SUPPORT=y
BR2_LINUX_KERNEL_INTREE_DTS_NAME="broadcom/bcm2712-rpi-cm5-cm5io broadcom/bcm2712-rpi-cm5l-cm5io"
BR2_LINUX_KERNEL_NEEDS_HOST_OPENSSL=y
BR2_PACKAGE_LINUX_TOOLS_GPIO=y
BR2_PACKAGE_BUSYBOX_SHOW_OTHERS=y
BR2_PACKAGE_ALSA_UTILS=y
BR2_PACKAGE_ALSA_UTILS_APLAY=y
BR2_PACKAGE_ALSA_UTILS_SPEAKER_TEST=y
BR2_PACKAGE_FFMPEG=y
BR2_PACKAGE_FFMPEG_GPL=y
BR2_PACKAGE_FFMPEG_NONFREE=y
BR2_PACKAGE_FFMPEG_FFPROBE=y
BR2_PACKAGE_XZ=y
BR2_PACKAGE_ZSTD=y
BR2_PACKAGE_GIT=y
BR2_PACKAGE_E2FSPROGS=y
BR2_PACKAGE_E2FSPROGS_RESIZE2FS=y
BR2_PACKAGE_BRCMFMAC_SDIO_FIRMWARE_RPI=y
BR2_PACKAGE_BRCMFMAC_SDIO_FIRMWARE_RPI_BT=y
BR2_PACKAGE_BRCMFMAC_SDIO_FIRMWARE_RPI_WIFI=y
BR2_PACKAGE_RPI_FIRMWARE=y
BR2_PACKAGE_RPI_FIRMWARE_CONFIG_FILE="$(BR2_EXTERNAL_ODY_TREE_PATH)/board/tpu/config-cm5.txt"
BR2_PACKAGE_RPI_FIRMWARE_CMDLINE_FILE="$(BR2_EXTERNAL_ODY_TREE_PATH)/board/tpu/cmdline.txt"
BR2_PACKAGE_GPSD=y
BR2_PACKAGE_GPSD_DEVICES="/dev/ttyAMA5 /dev/pps0"
BR2_PACKAGE_GPSD_PYTHON=y
BR2_PACKAGE_LM_SENSORS=y
BR2_PACKAGE_MINICOM=y
BR2_PACKAGE_PPS_TOOLS=y
BR2_PACKAGE_RASPI_GPIO=y
BR2_PACKAGE_USBIP=y
BR2_PACKAGE_LIBARCHIVE=y
BR2_PACKAGE_CA_CERTIFICATES=y
BR2_PACKAGE_OPENSSL=y
BR2_PACKAGE_PIXMAN=y
BR2_PACKAGE_DTC=y
BR2_PACKAGE_DTC_PROGRAMS=y
BR2_PACKAGE_LIBV4L=y
BR2_PACKAGE_LIBV4L_UTILS=y
BR2_PACKAGE_X264=y
BR2_PACKAGE_LIBCURL=y
# BR2_PACKAGE_LIBCURL_COOKIES_SUPPORT is not set
# BR2_PACKAGE_LIBCURL_EXTRA_PROTOCOLS_FEATURES is not set
BR2_PACKAGE_BMON=y
BR2_PACKAGE_CAN_UTILS=y
BR2_PACKAGE_CHRONY=y
BR2_PACKAGE_DHCPCD=y
BR2_PACKAGE_DROPBEAR=y
BR2_PACKAGE_GESFTPSERVER=y
# BR2_PACKAGE_IFUPDOWN_SCRIPTS is not set
BR2_PACKAGE_IPERF3=y
BR2_PACKAGE_IPROUTE2=y
BR2_PACKAGE_IPUTILS=y
BR2_PACKAGE_IW=y
BR2_PACKAGE_MOSQUITTO=y
BR2_PACKAGE_WIRELESS_REGDB=y
BR2_PACKAGE_WPA_SUPPLICANT=y
BR2_PACKAGE_WPA_SUPPLICANT_DEBUG_SYSLOG=y
BR2_PACKAGE_WPA_SUPPLICANT_CLI=y
BR2_PACKAGE_WPA_SUPPLICANT_PASSPHRASE=y
BR2_PACKAGE_DOCKER_CLI=y
BR2_PACKAGE_DOCKER_COMPOSE=y
BR2_PACKAGE_DOCKER_ENGINE=y
BR2_PACKAGE_HTOP=y
BR2_PACKAGE_KMOD_TOOLS=y
BR2_PACKAGE_NANO=y
BR2_TARGET_ROOTFS_EXT2=y
BR2_TARGET_ROOTFS_EXT2_4=y
BR2_TARGET_ROOTFS_EXT2_SIZE="4G"
# BR2_TARGET_ROOTFS_TAR is not set
BR2_PACKAGE_HOST_DOSFSTOOLS=y
BR2_PACKAGE_HOST_GENIMAGE=y
BR2_PACKAGE_HOST_GO_BIN=y
BR2_PACKAGE_HOST_KMOD_XZ=y
BR2_PACKAGE_HOST_MTOOLS=y
BR2_PACKAGE_RPI_DTLOADER=y
BR2_PACKAGE_RPI_DTLOADER_FILES="$(BR2_EXTERNAL_ODY_TREE_PATH)/board/tpu/mcp2515-can0-spi4.dts"
BR2_PACKAGE_CALYPSO=y
BR2_PACKAGE_MQTTUI=y
BR2_PACKAGE_RPI_UTILS=y
BR2_PACKAGE_RPI_UTILS_PINCTRL=y
BR2_PACKAGE_TPU_TELEMETRY=y
BR2_PACKAGE_ODYSSEUS_DAEMON=y
BR2_PACKAGE_MORSE=y
BR2_PACKAGE_MM6108_DRIVER=y
BR2_PACKAGE_MM6108_DRIVER_SPI=y
BR2_PACKAGE_MM6108_DRIVER_VENDOR_COMMAND=y
BR2_PACKAGE_MM6108_DRIVER_COUNTRY="US"
BR2_PACKAGE_MM6108_DRIVER_POWERSAVE_MODE=0
BR2_PACKAGE_MM6108_FIRMWARE=y
BR2_PACKAGE_RPI_LIBPISP=y
BR2_PACKAGE_RPICAM_APPS=y
```

## odysseus_tree/configs/raspberrypicm5io_wheel_defconfig
```kconfig
BR2_aarch64=y
BR2_cortex_a76=y
BR2_TOOLCHAIN_EXTERNAL=y
BR2_TOOLCHAIN_EXTERNAL_BOOTLIN=y
BR2_CCACHE=y
BR2_GLOBAL_PATCH_DIR="$(BR2_EXTERNAL_ODY_TREE_PATH)/patches board/raspberrypi/patches"
BR2_PER_PACKAGE_DIRECTORIES=y
BR2_TARGET_GENERIC_HOSTNAME="raspberrypi-wheel"
BR2_ROOTFS_DEVICE_CREATION_DYNAMIC_EUDEV=y
BR2_TARGET_GENERIC_ROOT_PASSWD="$(ODY_WHEEL_ROOT_PASSWORD)"
# BR2_TARGET_GENERIC_GETTY is not set
BR2_TARGET_TZ_INFO=y
BR2_TARGET_LOCALTIME="America/New_York"
BR2_ROOTFS_OVERLAY="$(BR2_EXTERNAL_ODY_TREE_PATH)/overlays/rootfs_overlay_common $(BR2_EXTERNAL_ODY_TREE_PATH)/overlays/rootfs_overlay_wheel"
BR2_ROOTFS_POST_BUILD_SCRIPT="$(BR2_EXTERNAL_ODY_TREE_PATH)/post-build-os-release.sh $(BR2_EXTERNAL_ODY_TREE_PATH)/post-build-base-connect.sh board/raspberrypicm5io/post-build.sh"
BR2_ROOTFS_POST_IMAGE_SCRIPT="board/raspberrypicm5io/post-image.sh"
BR2_ROOTFS_POST_SCRIPT_ARGS="WHEEL"
BR2_LINUX_KERNEL=y
BR2_LINUX_KERNEL_CUSTOM_TARBALL=y
BR2_LINUX_KERNEL_CUSTOM_TARBALL_LOCATION="$(call github,raspberrypi,linux,21b410140c47ffab5668399f6f143c7d7b935c8b)/linux-21b410140c47ffab5668399f6f143c7d7b935c8b.tar.gz"
BR2_LINUX_KERNEL_DEFCONFIG="bcm2712"
BR2_LINUX_KERNEL_CONFIG_FRAGMENT_FILES="board/raspberrypi/linux-4k-page-size.fragment $(BR2_EXTERNAL_ODY_TREE_PATH)/board/common/ody_common.fragment"
BR2_LINUX_KERNEL_DTS_SUPPORT=y
BR2_LINUX_KERNEL_INTREE_DTS_NAME="broadcom/bcm2712-rpi-cm5-cm5io broadcom/bcm2712-rpi-cm5l-cm5io"
BR2_LINUX_KERNEL_NEEDS_HOST_OPENSSL=y
BR2_PACKAGE_LINUX_TOOLS_GPIO=y
BR2_PACKAGE_BUSYBOX_SHOW_OTHERS=y
BR2_PACKAGE_XZ=y
BR2_PACKAGE_ZSTD=y
BR2_PACKAGE_GIT=y
BR2_PACKAGE_E2FSPROGS=y
BR2_PACKAGE_E2FSPROGS_RESIZE2FS=y
BR2_PACKAGE_DEJAVU=y
# BR2_PACKAGE_DEJAVU_SANS is not set
# BR2_PACKAGE_DEJAVU_SERIF is not set
# BR2_PACKAGE_DEJAVU_SANS_CONDENSED is not set
# BR2_PACKAGE_DEJAVU_SERIF_CONDENSED is not set
BR2_PACKAGE_KMSCUBE=y
BR2_PACKAGE_MESA3D=y
BR2_PACKAGE_MESA3D_GALLIUM_DRIVER_V3D=y
BR2_PACKAGE_MESA3D_OPENGL_ES=y
BR2_PACKAGE_PSPLASH=y
BR2_PACKAGE_PSPLASH_IMAGE="$(BR2_EXTERNAL_ODY_TREE_PATH)/board/wheel/ner-logo-dark.png"
BR2_PACKAGE_SDL2=y
BR2_PACKAGE_QT6=y
BR2_PACKAGE_QT6BASE_EGLFS=y
BR2_PACKAGE_QT6BASE_DEFAULT_QPA="eglfs"
BR2_PACKAGE_QT6BASE_JPEG=y
BR2_PACKAGE_QT6BASE_PNG=y
BR2_PACKAGE_QT6DECLARATIVE=y
BR2_PACKAGE_QT6DECLARATIVE_QUICK=y
BR2_PACKAGE_QT6GRPC=y
BR2_PACKAGE_QT6MQTT=y
BR2_PACKAGE_QT6SVG=y
BR2_PACKAGE_BRCMFMAC_SDIO_FIRMWARE_RPI=y
BR2_PACKAGE_BRCMFMAC_SDIO_FIRMWARE_RPI_BT=y
BR2_PACKAGE_BRCMFMAC_SDIO_FIRMWARE_RPI_WIFI=y
BR2_PACKAGE_RPI_FIRMWARE=y
BR2_PACKAGE_RPI_FIRMWARE_CONFIG_FILE="$(BR2_EXTERNAL_ODY_TREE_PATH)/board/wheel/config-cm5.txt"
BR2_PACKAGE_RPI_FIRMWARE_CMDLINE_FILE="$(BR2_EXTERNAL_ODY_TREE_PATH)/board/wheel/cmdline.txt"
BR2_PACKAGE_I2C_TOOLS=y
BR2_PACKAGE_LM_SENSORS=y
BR2_PACKAGE_MINICOM=y
BR2_PACKAGE_RASPI_GPIO=y
BR2_PACKAGE_CA_CERTIFICATES=y
BR2_PACKAGE_OPENSSL=y
BR2_PACKAGE_FONTCONFIG=y
BR2_PACKAGE_HARFBUZZ=y
BR2_PACKAGE_PIXMAN=y
BR2_PACKAGE_DTC=y
BR2_PACKAGE_DTC_PROGRAMS=y
BR2_PACKAGE_X264=y
BR2_PACKAGE_LIBCURL=y
# BR2_PACKAGE_LIBCURL_COOKIES_SUPPORT is not set
# BR2_PACKAGE_LIBCURL_EXTRA_PROTOCOLS_FEATURES is not set
BR2_PACKAGE_BMON=y
BR2_PACKAGE_CAN_UTILS=y
BR2_PACKAGE_CHRONY=y
BR2_PACKAGE_DHCPCD=y
BR2_PACKAGE_DROPBEAR=y
BR2_PACKAGE_GESFTPSERVER=y
# BR2_PACKAGE_IFUPDOWN_SCRIPTS is not set
BR2_PACKAGE_IPERF3=y
BR2_PACKAGE_IPROUTE2=y
BR2_PACKAGE_IPUTILS=y
BR2_PACKAGE_IW=y
BR2_PACKAGE_MOSQUITTO=y
BR2_PACKAGE_WIRELESS_REGDB=y
BR2_PACKAGE_WPA_SUPPLICANT=y
BR2_PACKAGE_WPA_SUPPLICANT_DEBUG_SYSLOG=y
BR2_PACKAGE_WPA_SUPPLICANT_CLI=y
BR2_PACKAGE_WPA_SUPPLICANT_PASSPHRASE=y
BR2_PACKAGE_DOCKER_CLI=y
BR2_PACKAGE_DOCKER_COMPOSE=y
BR2_PACKAGE_DOCKER_ENGINE=y
BR2_PACKAGE_HTOP=y
BR2_PACKAGE_KMOD_TOOLS=y
BR2_PACKAGE_NANO=y
BR2_TARGET_ROOTFS_EXT2=y
BR2_TARGET_ROOTFS_EXT2_4=y
BR2_TARGET_ROOTFS_EXT2_SIZE="4G"
# BR2_TARGET_ROOTFS_TAR is not set
BR2_PACKAGE_HOST_DOSFSTOOLS=y
BR2_PACKAGE_HOST_GENIMAGE=y
BR2_PACKAGE_HOST_GO_BIN=y
BR2_PACKAGE_HOST_KMOD_XZ=y
BR2_PACKAGE_HOST_MTOOLS=y
BR2_PACKAGE_RPI_DTLOADER=y
BR2_PACKAGE_RPI_DTLOADER_FILES="$(BR2_EXTERNAL_ODY_TREE_PATH)/board/wheel/lp5018a.dts"
BR2_PACKAGE_NERO2=y
BR2_PACKAGE_CALYPSO=y
BR2_PACKAGE_MQTTUI=y
BR2_PACKAGE_RPI_UTILS=y
BR2_PACKAGE_RPI_UTILS_PINCTRL=y
BR2_PACKAGE_ODYSSEUS_DAEMON=y
BR2_PACKAGE_WHEEL_BUTTONS=y
```

## odysseus_tree/package/ajax/Config.in
```kconfig
config BR2_PACKAGE_AJAX
    bool "ajax"
    depends on BR2_PACKAGE_HOST_RUSTC_TARGET_ARCH_SUPPORTS
    select BR2_PACKAGE_HOST_RUSTC
    help
        The NER Flash-over-CAN utility.
        
        Written in Rust, utlizing socketcand.

        https://github.com/Northeastern-Electric-Racing/Ajax
```

## odysseus_tree/package/base-telemetry/Config.in
```kconfig
config BR2_PACKAGE_BASE_TELEMETRY
    bool "base station telemetry sending"
    select BR2_PACKAGE_PYTHON_GMQTT
    select BR2_PACKAGE_PYTHON_PSUTIL
    select BR2_PACKAGE_PYTHON_PROTOBUF
    select BR2_PACKAGE_PYTHON_CAN
    depends on BR2_PACKAGE_GPSD_PYTHON
    depends on BR2_PACKAGE_TELEMETRY
    help
        Fast script scrape and send 
        Base Station data to a MQTT broker locally.
```

## odysseus_tree/package/microchip-t1s/Config.in
```kconfig
config BR2_PACKAGE_MICROCHIP_T1S
	bool "microchip-t1s"
	help
		This is the kernel module for all Microchip T1S products
```

## odysseus_tree/package/mm6108-driver/Config.in
```kconfig
config BR2_PACKAGE_MM6108_DRIVER
	bool "mm6108-driver"
	help
		This is the driver for the MM6108 Wifi HaLow SoC


if BR2_PACKAGE_MM6108_DRIVER

comment "Build options"

config BR2_PACKAGE_MM6108_DRIVER_SDIO
	bool "SDIO support"
	help
	  This driver supports wireless cards connected over SDIO.

	  The kernel device tree must be configured appropriately
	  for the host/device interface.
	  Both SDIO and SPI drivers may be enabled simultaneously.

config BR2_PACKAGE_MM6108_DRIVER_USB
	bool "USB support"
	help
	  This driver supports wireless cards connected over USB.

config BR2_PACKAGE_MM6108_DRIVER_SDIO_ALIGNMENT
	int "Alignment requirements for bulk SDIO reads/writes"
	default 2
	range 2 8
	help
	  Number of bytes to align data buffers for bulk SDIO transactions. Some hosts have
	  specific alignment requirements for DMA, use this setting to
	  adjust the alignment required.

	  Must be a power of 2.

config BR2_PACKAGE_MM6108_DRIVER_SPI
	bool "SPI support"
	help
	  This driver supports wireless cards connected over SPI.

	  The kernel device tree must be configured appropriately
	  for the host/device interface.
	  Both SDIO and SPI drivers may be enabled simultaneously.

config BR2_PACKAGE_MM6108_DRIVER_SPI_RK3288
	bool "SPI support for Rockchip 3288"
	default n
	depends on MORSE_SPI
	help
	  This driver supports the Rockchip 3288 SPI interface.

	  Special handling is required for this board because initialisation
	  of the Morse chip in SPI mode requires a handshake with the SPI CS
	  line held high, which is not supported in the Rockchip driver.

	  When enabled, the Morse SPI driver must be brought up before the
	  Rockchip SPI driver.

config BR2_PACKAGE_MM6108_DRIVER_USER_ACCESS
	bool "User space access support"
	help
	  Enable user-space access to wireless cards.

config BR2_PACKAGE_MM6108_DRIVER_VENDOR_COMMAND
	bool "Morse vendor commands"
	default n
	help
	  Allow vendor-specific commands from userspace applications such as iw.

config BR2_PACKAGE_MM6108_DRIVER_COUNTRY
	string "Country code for regulatory compliance"
	default "AU"
	help
	  Two-character country code.

config BR2_PACKAGE_MM6108_DRIVER_DEBUG_MASK
	int "Debug mask"
	default 8
	help
	  Set the Morse driver debug level.
	  Choose any combination of 8 (Error), 4 (Warning), 2 (Informational) and 1 (Debug).
	  The minimum debug level applied is 8 (Error).
	  Note that increasing debug level can impact performance.

config BR2_PACKAGE_MM6108_DRIVER_SDIO_RESET_TIME
	int "Time to wait after SDIO reset (ms)"
	default 400
	range 0 400
	help
	  Reduce the wait time after SDIO reset to reduce boot time.
	  Can cause instability and load failure if set too low for the device.

config BR2_PACKAGE_MM6108_DRIVER_POWERSAVE_MODE
	int "Power Save mode"
	default 2
	range 0 2
	help
	  Choose 0 to disable Power Save, 1 to enable the Power Save protocol, or 2 to fully enable
	  Power Save mode.

config BR2_PACKAGE_MM6108_DRIVER_DHCP_OFFLOAD
	bool "Offload DHCP lease renewal processing to the firmware"
	default n
	help
	  When enabled, DHCP lease renewal and discovery is handled by the firmware, with no
	  interaction with the host device. Only basic DHCP options are supported.

config BR2_PACKAGE_MM6108_DRIVER_ARP_OFFLOAD
	bool "Offload ARP packet handling to the firmware"
	default n
	help
	  When enabled, the firmware will directly respond to ARP requests for the wireless
	  interface's IP address, with no interaction with the host device. All other ARP requests
	  are ignored.

config BR2_PACKAGE_MM6108_DRIVER_WATCHDOG_RESET_DEFAULT_DISABLED
	bool "Disable driver reset from watchdog by default"
	default y
	help
	  When not set, if the watchdog detects an unrecoverable error, the default behaviour is to
	  reset the firmware. When set, the default behaviour is to not reset the firmware.
	  This setting can be overridden when loading the driver, by setting the enable_watchdog
	  parameter.

config BR2_PACKAGE_MM6108_DRIVER_DISABLE_CHANNEL_SURVEY
	bool "Disable channel survey"
	default n
	help
	  When set, the firmware will not perform channel surveys.

config BR2_PACKAGE_MM6108_DRIVER_ANDROID
	bool "Android build"
	default n
	help
	  Enable to compile driver for android.

config BR2_PACKAGE_MM6108_DRIVER_MONITOR
	bool "Monitor mode support"
	default n
	help
	  Enable to monitor traffic in a wireless channel.

config BR2_PACKAGE_MM6108_DRIVER_DEBUGFS
	bool "DebugFS support"
	default n
	help
	  Enable for debugging support.

endif
```

## odysseus_tree/package/mm6108-firmware/Config.in
```kconfig
config BR2_PACKAGE_MM6108_FIRMWARE
	bool "mm6108-firmware"
	help
		This is the firmware for the MM6108 Wifi HaLow SoC

		Note like the upstream, this package does not respect Morse Micro versions
```
