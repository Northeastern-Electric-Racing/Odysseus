## odysseus_tree/package/morse-cli/Config.in
```kconfig
config BR2_PACKAGE_MORSE_CLI
	bool "morse-cli"
	depends on BR2_PACKAGE_LIBUSB
	help
		This is the driver for the MM6108 Wifi HaLow SoC
```

## odysseus_tree/package/morse/Config.in
```kconfig
menuconfig BR2_PACKAGE_MORSE
	bool "morse"
	help
	  This option enables the Morse HaLow SDK. Sub-options allow to
	  select which modules should be built.

	  https://morsemicro.com


if BR2_PACKAGE_MORSE

source "$BR2_EXTERNAL_ODY_TREE_PATH/package/morse/mm6108-driver/Config.in"
source "$BR2_EXTERNAL_ODY_TREE_PATH/package/morse/mm6108-firmware/Config.in"
source "$BR2_EXTERNAL_ODY_TREE_PATH/package/morse/morse-cli/Config.in"

endif
```

## odysseus_tree/package/nerlibzenoh-c/Config.in
```kconfig
config BR2_PACKAGE_NERLIBZENOH_C # ***
	bool "nerlibzenoh-c" # ***
	depends on BR2_PACKAGE_LIBZENOH_C_ARCH_SUPPORTS
	depends on BR2_TOOLCHAIN_USES_GLIBC
	depends on !BR2_PACKAGE_LIBZENOH_C # ***
	select BR2_PACKAGE_HOST_RUSTC
	help
	  This package provides a C binding based on the main
	  Zenoh implementation written in Rust.

	  https://github.com/eclipse-zenoh/zenoh-c

comment "nerlibzenoh-c needs a glibc toolchain" # ***
	depends on BR2_PACKAGE_LIBZENOH_C_ARCH_SUPPORTS
	depends on !BR2_TOOLCHAIN_USES_GLIBC
```

## odysseus_tree/package/nero2/Config.in
```kconfig
config BR2_PACKAGE_NERO2
    bool "nero2"
    depends on BR2_PACKAGE_QT6 && BR2_PACKAGE_QT6BASE_NETWORK && BR2_PACKAGE_QT6BASE_PNG
    depends on BR2_PACKAGE_QT6DECLARATIVE && BR2_PACKAGE_QT6DECLARATIVE_QUICK
    depends on BR2_PACKAGE_QT6SVG && BR2_PACKAGE_QT6GRPC
    depends on BR2_PACKAGE_LIBZENOH_C_ARCH_SUPPORTS # nerlibzenoh-c
    depends on BR2_TOOLCHAIN_USES_GLIBC # nerlibzenoh-c
    depends on !BR2_PACKAGE_LIBZENOH_C # nerlibzenoh-c
    select BR2_PACKAGE_QT6CORE5COMPAT
    select BR2_PACKAGE_NERLIBZENOH_C
    help
        Nero v2.0 custom dashboard for NER.

        Built with qt6.
        
        https://github.com/Northeastern-Electric-Racing/Nero-2.0
```

## odysseus_tree/package/probe-rs/Config.in
```kconfig
config BR2_PACKAGE_PROBE_RS
	bool "probe-rs"
	depends on BR2_PACKAGE_HOST_RUSTC_ARCH_SUPPORTS
	select BR2_PACKAGE_HOST_RUSTC
	select BR2_PACKAGE_LIBUSB
	select BR2_PACKAGE_HAS_UDEV
	help
	  A modern, Rust-focused software suite designed to work with
	  debuggers in embedded systems.

	  https://probe.rs
```

## odysseus_tree/package/pythia-backend/Config.in
```kconfig
config BR2_PACKAGE_PYTHIA_BACKEND
    bool "pythia backend"
    depends on BR2_PACKAGE_HOST_RUSTC_TARGET_ARCH_SUPPORTS
    select BR2_PACKAGE_HOST_RUSTC
    select BR2_PACKAGE_SQLITE
    help
        The Pythia HIL test profile backend.

        Written in Rust, serves a REST API on port 3000 backed by
        a SQLite database of test profiles and CAN messages.

        https://github.com/Northeastern-Electric-Racing/Pythia
```

## odysseus_tree/package/pythia-frontend/Config.in
```kconfig
config BR2_PACKAGE_PYTHIA_FRONTEND
    bool "pythia frontend"
    depends on BR2_PACKAGE_HOST_NODEJS_BIN_ARCH_SUPPORTS || BR2_HOST_GCC_AT_LEAST_8
    depends on BR2_PACKAGE_PYTHIA_BACKEND
    select BR2_PACKAGE_HOST_NODEJS
    select BR2_PACKAGE_NGINX
    select BR2_PACKAGE_NGINX_HTTP
    select BR2_PACKAGE_NGINX_HTTP_PROXY_MODULE
    help
        The Pythia HIL test profile web UI.

        Angular app served by nginx on port 80, proxying API calls
        to pythia-backend. Not started at boot, toggle it with
        `pythia-frontend start|stop|status`.

        NOTE: Runs `npm ci` during the build, requires network access!

        https://github.com/Northeastern-Electric-Racing/Pythia
```

## odysseus_tree/package/telemetry/Config.in
```kconfig
config BR2_PACKAGE_TELEMETRY
    bool "telemetry base package"
    select BR2_PACKAGE_PYTHON_GMQTT
    select BR2_PACKAGE_PYTHON_PSUTIL
    select BR2_PACKAGE_PYTHON_PROTOBUF
    select BR2_PACKAGE_PYTHON_CAN
    depends on BR2_PACKAGE_GPSD_PYTHON
    help
        Fast script scrape and send 
        data to a MQTT broker locally.
```

## odysseus_tree/package/wheel-buttons/Config.in
```kconfig
config BR2_PACKAGE_WHEEL_BUTTONS
    bool "wheel-buttons"
    select BR2_PACKAGE_LIBGPIOD2
	help
        Unix socket interface for device buttons to Nero dashboard communication.
```

## odysseus_tree/package/zenohd/Config.in
```kconfig
config BR2_PACKAGE_ZENOHD
    bool "zenohd"
    depends on BR2_PACKAGE_HOST_RUSTC_TARGET_ARCH_SUPPORTS
    select BR2_PACKAGE_HOST_RUSTC
    help
        The Zenoh router daemon.
        
        https://github.com/eclipse-zenoh/zenoh
```
